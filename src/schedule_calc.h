#pragma once
#include <stdint.h>

// ============================================================
//  schedule_calc.h — кто когда просыпается в main.cpp.
//
//  Без Arduino: время приходит параметром, собирается нативно и
//  покрыто тестами. Раньше всё это жило прямо в main.cpp, и именно
//  эти куски переписывались чаще всего — каждый раз без теста.
// ============================================================

// ─── Условие, которое должно продержаться ─────────────────
// Два места ждут, пока плохое состояние продержится заданное время, и только
// потом действуют: ноль шкалы перед глубоким сном (одиночный выброс АЦП не
// должен стоить пяти минут темноты) и обрыв Wi-Fi перед своим reconnect()
// (сначала отрабатывает авто-реконнект ядра). Раньше у каждого был свой
// static uint32_t и своя копия «now ? now : 1».
//
// 0 в since занят под «условие не держится», поэтому момент 0 пишется как 1:
// на старте millis() бывает и нулём.
struct HoldTimer {
    enum Event : uint8_t {
        NONE,       // ничего нового
        STARTED,    // условие только что появилось — повод для строки в журнале
        ELAPSED,    // продержалось holdMs; отсчёт начат заново
    };

    uint32_t since = 0;

    // Отсчёт после ELAPSED начинается заново, а не встаёт: обрыву Wi-Fi нужен
    // повтор reconnect() раз в holdMs, пока связь не вернётся. Глубокому сну
    // всё равно — из него в этот код не возвращаются.
    Event step(bool active, uint32_t nowMs, uint32_t holdMs) {
        if (!active) { since = 0; return NONE; }
        if (since == 0) { since = nowMs ? nowMs : 1; return STARTED; }
        if (nowMs - since < holdMs) return NONE;
        since = nowMs ? nowMs : 1;
        return ELAPSED;
    }
};

// ─── Когда опрашивать датчик ──────────────────────────────
// Замер привязан к началу минуты по часам, а не к моменту включения: раньше
// интервал отсчитывался от millis() загрузки, и показания обновлялись в
// произвольную секунду (12:34:17, 12:35:17 …). Сравнить их с чем-то по
// времени было нельзя, а точки графика ложились вразнобой относительно минут.
struct SensorClock {
    uint32_t lastMs  = 0;    // millis() последнего замера
    int      lastMin = -1;   // минута последнего замера по часам, -1 — ещё не было

    // minute — минута по часам, < 0 — часы не встали. true — пора мерить;
    // момент замера запоминается здесь же.
    bool due(uint32_t nowMs, int minute, uint32_t intervalMs) {
        if (minute < 0) {
            // NTP ещё не ответил — минут у нас нет, работает прежний отсчёт
            // от millis(). Иначе датчик молчал бы до синхронизации.
            if (nowMs - lastMs < intervalMs) return false;
            lastMs = nowMs;
            return true;
        }
        if (minute == lastMin) return false;   // в эту минуту уже мерили

        // Время только что появилось — на старте из RTC или с первым ответом
        // NTP. Последний замер был по millis() (или в setup()) секунды назад,
        // и мерить прямо сейчас значило бы положить в историю дубль посреди
        // минуты. Ждём начала ближайшей подходящей минуты, как и дальше.
        if (lastMin < 0) {
            lastMin = minute;
            return false;
        }

        // В экономе опрос раз в две минуты — берём чётные, чтобы момент замера
        // не зависел от того, когда устройство включили. Ноль в делителе тут
        // означал бы деление на ноль, поэтому шаг не опускается ниже минуты.
        uint32_t everyMin = intervalMs / 60000UL;
        if (everyMin < 1) everyMin = 1;
        if ((uint32_t)minute % everyMin != 0) return false;

        lastMin = minute;
        lastMs  = nowMs;
        return true;
    }
};

// ─── Пауза цикла в простое ────────────────────────────────
// Сколько спать до следующего оборота loop(), пока секундомер не идёт.
// Просыпаться стоит сразу после смены секунды: на ней меняется кадр, и
// пробуждение в любой другой момент — это задержка часов на экране и
// дашборде. Но не позже maxMs: между секундами loop() набирает отсчёты АЦП
// и двигает автомат подключения.
//
// Раньше пауза была постоянной, 20 мс: пятьдесят оборотов в секунду, из
// которых кадр менялся на одном. Пока процессор не спит, лишний оборот стоит
// десятки микросекунд. С light sleep каждый — это выход из сна, и пятьдесят
// таких в секунду съели бы часть того, ради чего сон включали.
//
// msIntoSecond — сколько миллисекунд текущей секунды уже прошло (0..999).
// +1 — чтобы проснуться уже после границы, а не за миг до неё: тик FreeRTOS
// округляет паузу, и ранний подъём стоил бы лишнего оборота впустую.
inline uint32_t loopIdlePauseMs(uint32_t msIntoSecond, uint32_t maxMs) {
    if (msIntoSecond > 999) msIntoSecond = 999;
    uint32_t toNext = 1000 - msIntoSecond + 1;   // 2..1001
    uint32_t p = toNext < maxMs ? toNext : maxMs;
    return p ? p : 1;                            // ноль — это не пауза, а спин
}
