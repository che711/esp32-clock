#pragma once
#include <stdint.h>

// ============================================================
//  screen_calc.h — когда экрану гореть: окно расписания, ночная
//  подсветка и рубеж по заряду.
//
//  Без Arduino: собирается нативно и покрыто тестами. Здесь —
//  только решения; панель, журнал и яркость трогает main.cpp.
//  Раньше и то и другое жило в main.cpp вперемешку, и этот кусок
//  переписывался чаще прочих: фронт окна, подсветка, вето заряда.
//
//  Сами условия приходят готовыми: рубеж по заряду с гистерезисом
//  считает power.cpp (powerScreenBatteryOkNow), окно по часу —
//  power_calc.h (powerScreenAllowed), право зажигать панель самим —
//  профиль режима (screenAutoOn).
// ============================================================

enum ScreenAction : uint8_t {
    SCREEN_KEEP,        // панель не трогать
    SCREEN_TURN_ON,
    SCREEN_TURN_OFF,
};

// Почему команда «включить» не выполнена. У двух отказов противоположные
// советы пользователю — подождать зарядки или поднять ползунок, — поэтому
// различать их надо.
enum ScreenRefusal : uint8_t {
    SCREEN_REFUSED_NONE,
    SCREEN_REFUSED_BATTERY,
    SCREEN_REFUSED_BRIGHTNESS,
};

struct ScreenStep {
    ScreenAction action;
    bool         peekExpired;   // подсветка только что истекла — строка в журнал
};

struct ScreenSchedule {
    // В эконом-режимах вне рабочего окна панель гасится совсем: это самая
    // крупная статья расхода, и ночью она всё равно никому не светит.
    //
    // Зажигать панель сама автоматика вправе только в обычном режиме (autoOn
    // профиля): утром, когда начинается день, и когда исчезает причина
    // гашения — заряд вернулся или эконом сменили на обычный. Ручное
    // выключение там живёт до ближайшего утра. В экономе автоматика панель
    // только гасит: после ночи, после рубежа по заряду, после кнопки экран
    // ждёт, пока его включат. Смотреть на часы в экономе приходят сами, а
    // экран, вспыхнувший в 6:00 в пустой комнате, горит до первого взгляда.
    //
    // Раньше было наоборот. Утро наступало по фронту окна, а окно есть только
    // у эконома, и обычный режим утра не знал вовсе: выключенный в нём экран
    // оставался тёмным, пока его не включат, — так часы и встретили
    // воскресное утро 4 октября. Эконом же зажигал в 6:00 и экран, погашенный
    // кнопкой нарочно.
    //
    // Ещё раньше здесь стоял флаг «погасили мы сами», и взводился он, только
    // если в момент закрытия окна панель горела. Выключенный кнопкой днём
    // экран проходил границу 22:00 незамеченным, и в 6:00 включать было
    // нечего. Состояние панели о намерении пользователя не говорит ничего,
    // граница — говорит, поэтому помним границы, а не панель.
    bool allowedPrev = true;     // окно на прошлом шаге; true — на старте фронта нет
    bool dayPrev     = true;     // день на прошлом шаге; то же правило старта

    // Ночью посмотреть на часы всё-таки надо, поэтому команда «включить экран»
    // работает и в запрещённый час — но не навсегда: панель горит peekMs, и
    // гасим её сами. Забыть выключить легко, а расплата за забытый экран —
    // самый крупный потребитель, горящий до утра.
    uint32_t peekUntil = 0;      // millis() конца подсветки; 0 — подсветки нет

    // Раз в секунду. battOk — рубеж по заряду пропускает, schedOk — час
    // рабочий по окну режима или неизвестен, dayOk — час дневной или
    // неизвестен, независимо от режима: окна у обычного нет, а утро есть.
    // autoOn — профиль разрешает зажигать панель самим, panelOn — панель
    // сейчас светится.
    ScreenStep tick(uint32_t nowMs, bool battOk, bool schedOk, bool dayOk,
                    bool autoOn, bool panelOn) {
        ScreenStep s = { SCREEN_KEEP, false };
        bool allowed = battOk && schedOk;

        // Фронты считаем здесь, до раннего выхода по подсветке, и в любом
        // режиме: иначе ночное «посмотреть на часы» съедало бы переход, а
        // фронт, пришедшийся на эконом, доставался бы обычному режиму после
        // переключения — экран вспыхивал бы среди дня от давно прошедшего утра.
        bool opened  = allowed && !allowedPrev;
        bool morning = dayOk && !dayPrev;
        allowedPrev = allowed;
        dayPrev     = dayOk;

        // Пока идёт подсветка, расписание уступает — но только оно: рубеж по
        // заряду подсветка не перебивает. Полминуты OLED на исходе банки — это
        // не только лишние миллиампер-часы, но и просадка напряжения, из-за
        // которой чип уходит в brownout: часы не «покажут время напоследок», а
        // выключатся совсем. Истечёт подсветка — и этот же шаг погасит панель
        // обычным путём.
        //
        // Сравнение через знаковую разность, а не «now < until»: так подсветка
        // переживает переполнение millis() на 49-м дне работы.
        if (!allowed && battOk && peekUntil != 0) {
            if ((int32_t)(nowMs - peekUntil) < 0) return s;
            peekUntil = 0;
            s.peekExpired = true;
        }

        // Час стал рабочим — подсветку снимаем: экран и так горит по
        // расписанию, а оставленный отсчёт врал бы в дашборде про скорое
        // гашение.
        if (allowed) peekUntil = 0;

        if (!allowed) {
            if (panelOn) s.action = SCREEN_TURN_OFF;
        } else if (autoOn && (opened || morning) && !panelOn) {
            s.action = SCREEN_TURN_ON;
        }
        return s;
    }

    // Команда «включить» из дашборда. levelZero — яркость на нуле, nightNow —
    // час известен и нерабочий. SCREEN_REFUSED_NONE — панель включать.
    ScreenRefusal requestOn(uint32_t nowMs, bool battOk, bool levelZero,
                            bool nightNow, uint32_t peekMs) {
        // Рубеж по заряду не обходится ничем, в том числе этой командой: иначе
        // подсветка сводила бы его на нет — зажгли на полминуты, и она же
        // уронила устройство в brownout. Часа для проверки не нужно, поэтому
        // она работает и без синхронизации времени.
        if (!battOk) {
            peekUntil = 0;
            return SCREEN_REFUSED_BATTERY;
        }

        // Яркость на нуле — панель не засветится, чем её ни включай: ноль гасит
        // её через power save, а не притушивает. Поднять уровень самим было бы
        // проще всего, и раньше так и делалось, — но это молча отменяет выбор
        // пользователя и разводит дашборд с железом: ползунок остаётся в нуле,
        // панель светит на 28 %. Пусть лучше команда честно не выполнится.
        if (levelZero) return SCREEN_REFUSED_BRIGHTNESS;

        if (nightNow) {
            peekUntil = nowMs + peekMs;
            if (peekUntil == 0) peekUntil = 1;   // 0 занят под «нет подсветки»
        } else {
            peekUntil = 0;       // час рабочий — гасить по таймеру незачем
        }
        return SCREEN_REFUSED_NONE;
    }

    // Погасили сами — досматривать нечего.
    void requestOff() { peekUntil = 0; }

    bool peeking() const { return peekUntil != 0; }

    // Сколько ещё гореть по подсветке, секунды; 0 — подсветки нет. Нужно
    // дашборду: без обратного отсчёта самопроизвольное гашение через полминуты
    // выглядит сбоем, а не задумкой. Округление вверх: «0 с» при ещё горящей
    // панели читалось бы как ошибка.
    uint32_t peekLeftS(uint32_t nowMs) const {
        if (peekUntil == 0) return 0;
        int32_t left = (int32_t)(peekUntil - nowMs);   // знаковая: см. tick()
        if (left <= 0) return 0;
        return ((uint32_t)left + 999) / 1000;
    }
};
